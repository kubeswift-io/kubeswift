## build/kernels/faas-minimal/configs/faas_minimal_defconfig
```kconfig
BR2_x86_64=y
BR2_TOOLCHAIN_BUILDROOT=y
BR2_TOOLCHAIN_BUILDROOT_MUSL=y
BR2_TOOLCHAIN_BUILDROOT_LIBC="musl"
BR2_STATIC_LIBS=y
BR2_LINUX_KERNEL=y
BR2_LINUX_KERNEL_LATEST_LTS_VERSION=y
BR2_LINUX_KERNEL_USE_CUSTOM_CONFIG=y
BR2_LINUX_KERNEL_CUSTOM_CONFIG_FILE="$(BR2_EXTERNAL)/configs/faas-minimal-linux.config"
BR2_LINUX_KERNEL_BZIMAGE=y
BR2_TARGET_ROOTFS_CPIO=y
BR2_TARGET_ROOTFS_CPIO_GZIP=y
BR2_PACKAGE_BUSYBOX=y
BR2_ROOTFS_INIT_BUSYBOX=y
BR2_ROOTFS_OVERLAY="$(BR2_EXTERNAL)/rootfs-overlay"
BR2_TARGET_GENERIC_HOSTNAME="faas"
BR2_TARGET_GENERIC_ISSUE=""
BR2_TARGET_GENERIC_ROOT_PASSWD=""
BR2_STRIP_strip=y
BR2_OPTIMIZE_S=y
```
